## Kconfig
```kconfig
# Sensor data simulator
#
# Copyright (c) 2019 Nordic Semiconductor
#
# SPDX-License-Identifier: LicenseRef-Nordic-5-Clause
#

rsource "src/pointing/Kconfig"

menuconfig POINTER_2S_MIXER
  bool "Pointer 2-sensor mixer"
  depends on INPUT

if POINTER_2S_MIXER

config POINTER_2S_MIXER_LAZY_INIT
  bool "Make all the calculations not on boot but on fist data event (useful to see logs)"
  default n

endif # POINTER_2S_MIXER
```

## dts/bindings/behaviors/zmk,behavior-p2sm-accel-adj.yaml
```yaml
description: Scroll acceleration adjustment
compatible: "zmk,behavior-p2sm-accel-adj"
include: two_param.yaml

properties:
  step:
    type: int
    required: true
    default: 50
  min-step:
    type: int
    required: true
    default: 1
  max-step:
    type: int
    required: true
    default: 1000

  max-multiplier:
    type: int
    default: 5

  wrap:
    type: boolean

  feedback-gpios:
    type: phandle-array
  feedback-extra-gpios:
    type: phandle-array
  feedback-wrap-pattern:
    type: array
  feedback-duration:
    type: int
    default: 0
```

## dts/bindings/behaviors/zmk,behavior-p2sm-accel-toggle.yaml
```yaml
description: Scroll acceleration toggle
compatible: "zmk,behavior-p2sm-accel-toggle"
include: one_param.yaml

properties:
  feedback-gpios:
    type: phandle-array
  feedback-extra-gpios:
    type: phandle-array
  feedback-duration:
    type: int
    default: 0
```

## dts/bindings/behaviors/zmk,behavior-p2sm-scroll-sens.yaml
```yaml
description: Scroll sensitivity
compatible: "zmk,behavior-p2sm-scroll-sens"
include: two_param.yaml

properties:
  step:
    type: int
    required: true
    default: 25 # must be a factor of (max-multiplier * 100); in percents
  max-multiplier:
    type: int
    required: true
    default: 1
```

## dts/bindings/behaviors/zmk,behavior-p2sm-sens.yaml
```yaml
description: Sensor sensitivity
compatible: "zmk,behavior-p2sm-sens"
include: two_param.yaml

properties:
  step:
    type: int
    required: true
    default: 250 # must be a factor of (max-multiplier * 1000); step = percents * 10
  min-step:
    type: int
    required: true
    default: 1
  max-step:
    type: int
    required: true
    default: 1000

  # for non-scroll behavior, max-multiplier is always 1
  scroll:
    type: boolean
  max-multiplier:
    type: int
    default: 1 # one might need to disable high-res scroll for >1 to make sense
```

## dts/bindings/behaviors/zmk,behavior-p2sm-twist-toggle.yaml
```yaml
description: Toggle twist scroll
compatible: "zmk,behavior-p2sm-twist-toggle"
include: zero_param.yaml

properties:
  feedback-duration:
    type: int
    default: 0
```

## dts/bindings/input_processors/zmk,input-processor-mixer.yaml
```yaml
# Copyright (c) 2024, The ZMK Contributors
# SPDX-License-Identifier: MIT

description: Input Processor for mixing values after input events

compatible: "zmk,input-processor-mixer"

include: ip_one_param.yaml

properties:
  sync-report-ms:
    type: int
    required: true
    default: 1
  sync-report-yaw-ms:
    type: int
    required: true
    default: 15
  yaw-div:
    type: int
    required: true
    default: 25
```

## dts/bindings/input_processors/zmk,pointer-2s-mixer.yaml
```yaml
description: Input Processor for mixing readings from two mouse sensors
compatible: "zmk,pointer-2s-mixer"
include: ip_one_param.yaml

properties:
  sync-report-ms:
    type: int
    required: true
    default: 2
  sync-scroll-report-ms:
    type: int
    required: true
    default: 8

  twist-interference-thres:
    type: int
    default: 200
    deprecated: true
  twist-interference-window:
    type: int
    default: 100
    deprecated: true

  # Zero = down left bottom (NOT BALL CENTER)
  sensor1-pos:
    type: uint8-array
    required: true
    default: [ (0), (80), (0) ]
  sensor2-pos:
    type: uint8-array
    required: true
    default: [ (ff), (80), (0) ]
  ball-radius:
    type: int
    required: true
    default: 120

  feedback-gpios:
    type: phandle-array
  feedback-extra-gpios:
    type: phandle-array
  twist-feedback-delay:
    type: int
    default: 5
```

## src/behaviors/Kconfig
```kconfig
# Copyright (c) 2023 The ZMK Contributors
# SPDX-License-Identifier: MIT

if ZMK_POINTER_2S_MIXER

config POINTER_2S_MIXER_SENS_DRIFT_CORRECTION
  int "Sensitivity drift correction threshold"
  default 15
  help
    In percents * 10. Value of 15 represents correction of ≥1.5% drift

config POINTER_2S_MIXER_SENS_MAX_DEVICES
  int "Maximum sensitivity cyclers in device tree"
  default 6

config POINTER_2S_MIXER_FEEDBACK_MAX_ARR_VALUES
  int "Maximum items in feedback pattern array"
  default 8

config POINTER_2S_MIXER_SETTINGS_SAVE_DELAY
  int "Debounce of the save operation, msec"
  default 2500

config POINTER_2S_MIXER_SENS_LOG_EN
  bool "Enable sensitivity cycler log"
  default y

endif # ZMK_POINTER_2S_MIXER
```

## src/mouse/Kconfig
```kconfig
# Copyright (c) 2023 The ZMK Contributors
# SPDX-License-Identifier: MIT

if ZMK_MOUSE

config ZMK_INPUT_PROCESSOR_MIXER
    bool "Event Mixer Input Processor"
    default y
    depends on DT_HAS_ZMK_INPUT_PROCESSOR_MIXER_ENABLED

endif
```

## src/pointing/Kconfig
```kconfig
if ZMK_POINTING

config ZMK_POINTER_2S_MIXER
    bool "2-sensor pointer mixer"
    default y
    depends on INPUT

endif

if ZMK_POINTER_2S_MIXER

config POINTER_2S_MIXER_LAZY_INIT
  bool "Lazy init"
  default n
  help
    Make all the calculations not on boot but on fist data event (useful to see logs)

config POINTER_2S_MIXER_ENSURE_SYNC
  bool "Ensure data from both sensors"
  default y
  help
    Do not calculate anything until both sensors start to report data

config POINTER_2S_MIXER_SYNC_WINDOW_MS
  int "Sync window, msec"
  default 24
  help
    Data from both sensors must come in this window

config POINTER_2S_MIXER_REMAINDER_TTL
  int "X/Y remainder TTL, msec"
  default 16

config POINTER_2S_MIXER_ZRC_POLL_MS
  int "ZRC cache refresh interval, msec"
  default 500
  help
    How often the hot path re-reads runtime-config values for both
    pointer and twist/scroll paths. The check runs inline on each
    sensor event, so polling happens only while the device is
    active. Larger values reduce ZRC lookup overhead at the cost of
    slower response when settings change. No effect when
    ZMK_RUNTIME_CONFIG is disabled.

config POINTER_2S_MIXER_ZRC_REFRESH_YIELD_US
  int "Yield between ZRC refresh reads, usec"
  default 10
  help
    Inserts a short k_usleep() between each read inside a cache
    refresh sweep so the back-to-back lookups don't starve other
    work on the input thread. Set to 0 to disable yielding (single
    burst).

config POINTER_2S_MIXER_TWIST_EN
  bool "Enable twist to scroll"
  default y

config POINTER_2S_MIXER_TWIST_REMAINDER_TTL
  int "Scroll remainder TTL, msec"
  default 32

config POINTER_2S_MIXER_TWIST_FILTER_TTL
  int "Time filter window, msec"
  default 100
  help
    Singular events in this timeframe (msec) will be filtered out

config POINTER_2S_MIXER_TWIST_FILTER_DEBOUNCE
  int "Time filter debouce, msec"
  default 24

config POINTER_2S_MIXER_DIRECTION_FILTER_EN
  bool "Direction filter"
  default y
  help
    First event in the opposite direction will be filtered out

config POINTER_2S_MIXER_DIRECTION_FILTER_TTL
    int "Direction filter value TTL, msec"
    default 500

config POINTER_2S_MIXER_34_FILTER_EN
  bool "3/4 filter"
  default y
  help
    Filter out movement events where 3 out of 4 values are below threshold

config POINTER_2S_MIXER_FEEDBACK_EN
  bool "Enable feedback"
  default y

config POINTER_2S_MIXER_SCROLL_DISABLES_POINTER
  bool "Scroll disables pointer"
  default n

config POINTER_2S_MIXER_POINTER_AFTER_SCROLL_ACTIVATION
  int "Period of pointer inactivity"
  default 100

config POINTER_2S_MIXER_TWIST_MAX_VALUE
  int "Maximum reasonable value for twist"
  default 750

config POINTER_2S_MIXER_DELTA_Y_OVER_TRANS_MAG_MUL
  int "Delta Y over translation mangitude multiplier"
  default 8

config POINTER_2S_MIXER_DELTA_Y_OVER_TRANS_MAG_DIV
  int "Delta Y over translation mangitude divisor"
  default 3

config POINTER_2S_MIXER_TWIST_HYST_EN
  bool "Twist threshold hysteresis"
  default y
  help
    Relax twist_thres and dy_mag_mul/div while a twist gesture is active
    (within TWIST_FILTER_TTL of last twist-relevant event). Lets slow
    continuation through without weakening start-of-gesture protection.

config POINTER_2S_MIXER_TWIST_HYST_THRES
  int "Active-twist threshold"
  default 1

config POINTER_2S_MIXER_TWIST_HYST_MUL
  int "Active-twist dy_mag multiplier"
  default 1

config POINTER_2S_MIXER_TWIST_HYST_DIV
  int "Active-twist dy_mag divisor"
  default 1

config POINTER_2S_MIXER_TWIST_THRES
  int "Twist threshold"
  default 4

config POINTER_2S_MIXER_TWIST_FEEDBACK_THRESHOLD
  int "Twist feedback accumulator threshold"
  default 100

config POINTER_2S_MIXER_TWIST_FEEDBACK_DURATION
  int "Twist feedback pulse duration, msec"
  default 0

config POINTER_2S_MIXER_FEEDBACK_MAX_CONTINUOUS
  int "Maximum continuous feedback duration, msec"
  default 150

config POINTER_2S_MIXER_FEEDBACK_COOLDOWN
  int "Feedback cooldown, msec"
  default 25

config POINTER_2S_MIXER_EMA_ALPHA
  int "Alpha-value for EMA filter, N/100"
  default 25

config POINTER_2S_MIXER_STEADY_THRES
  int "Non significant movement threshold"
  default 5

config POINTER_2S_MIXER_STEADY_COOLDOWN
  int "Twist after movement, msec"
  default 100

config POINTER_2S_MIXER_DEFAULT_MOVE_COEF
  int "Default pointer sensitivity in %"
  default 25

config POINTER_2S_MIXER_DEFAULT_TWIST_COEF
  int "Default twist scroll sensitivity in %"
  default 25

config POINTER_2S_MIXER_SMA_EN
  bool "Enable Simple Moving Average for pointer"
  default n
  help
    Apply SMA filtering to pointer movements

config POINTER_2S_MIXER_SMA_WINDOW_SIZE_MAX
  int "SMA maximum window size (number of samples)"
  default 12
  range 2 255
  depends on POINTER_2S_MIXER_SMA_EN
  help
    Maximum SMA window size allowed at runtime

config POINTER_2S_MIXER_SMA_WINDOW_SIZE
  int "SMA default window size (number of samples)"
  default 3
  depends on POINTER_2S_MIXER_SMA_EN

config POINTER_2S_MIXER_SMA_TIMEOUT
  int "SMA timeout, msec"
  default 64
  depends on POINTER_2S_MIXER_SMA_EN
  help
    Discard SMA history after no data for this duration

config POINTER_2S_MIXER_MEDIAN_EN
  bool "Enable median filter"
  default n

config POINTER_2S_MIXER_MEDIAN_WINDOW_SIZE_MAX
  int "Median maximum window size"
  default 24
  range 3 48

config POINTER_2S_MIXER_MEDIAN_WINDOW_SIZE
  int "Median default window size"
  default 3

endif # ZMK_POINTER_2S_MIXER
```

## src/shell/Kconfig
```kconfig
if SHELL

config ZMK_P2SM_SHELL
bool "Sensor mixer shell commands"
default y

endif
```
